## dts/bindings/test/vnd,test-spi.yaml
```yaml
# Copyright (c) 2022 Nordic Semiconductor ASA
# SPDX-License-Identifier: Apache-2.0

description: Test SPI

compatible: "vnd,test-spi"

include: base.yaml
```

## samples/bluetooth/beacon/sample.yaml
```yaml
sample:
  name: Bluetooth Beacon
tests:
  sample.bluetooth.beacon:
    harness: bluetooth
    platform_allow:
      - qemu_cortex_m3
      - qemu_x86
      - nrf51dk/nrf51822
      - nrf52dk/nrf52832
      
    tags: bluetooth
    integration_platforms:
      - qemu_cortex_m3
      - nrf51dk/nrf51822
      - nrf52dk/nrf52832
      
  sample.bluetooth.beacon-coex:
    extra_args: CONF_FILE="prj-coex.conf"
    harness: bluetooth
    platform_allow:
      - nrf52840dk/nrf52840
    integration_platforms:
      - nrf52840dk/nrf52840
    tags: bluetooth
```

## soc/nordic/common/vpr/Kconfig
```kconfig
# Copyright (c) 2024 Nordic Semiconductor ASA
# SPDX-License-Identifier: Apache-2.0

config RISCV_CORE_NORDIC_VPR
	bool
	select RISCV
	select RISCV_PRIVILEGED
	select RISCV_VECTORED_MODE
	select RISCV_ISA_RV32E
	select RISCV_ISA_EXT_M
	select RISCV_ISA_EXT_C
	select RISCV_ISA_EXT_ZICSR
	select RISCV_SOC_HAS_ISR_STACKING
	select RISCV_SOC_HAS_GP_RELATIVE_ADDRESSING
	select RISCV_HAS_CLIC
	select RISCV_SOC_CONTEXT_SAVE
	select HAS_FLASH_LOAD_OFFSET
	select ARCH_HAS_CUSTOM_CPU_IDLE if !SOC_SERIES_NRF54LX
	select ARCH_HAS_CUSTOM_CPU_ATOMIC_IDLE if !SOC_SERIES_NRF54LX
	select INCLUDE_RESET_VECTOR
	imply XIP
	help
	  Enable support for the RISC-V Nordic VPR core.

if RISCV_CORE_NORDIC_VPR

DEEP_SLEEP_PROP := nordic,deep-sleep-retain

config RISCV_CORE_NORDIC_VPR_DEEP_SLEEP
	bool "Enable deep sleep"
	depends on $(dt_nodelabel_bool_prop,cpu,$(DEEP_SLEEP_PROP))
	help
	  Enter deep sleep mode instead of sleep mode.

endif
```

## tests/arch/riscv/compressed/testcase.yaml
```yaml
tests:
  arch.riscv.compressed:
    arch_allow: riscv
    filter: >
      CONFIG_RISCV_ISA_EXT_ZCA or CONFIG_RISCV_ISA_EXT_ZCB or
      CONFIG_RISCV_ISA_EXT_ZCD or CONFIG_RISCV_ISA_EXT_ZCF or
      CONFIG_RISCV_ISA_EXT_ZCMP or CONFIG_RISCV_ISA_EXT_ZCMT
```

## tests/drivers/watchdog/wdt_error_cases/testcase.yaml
```yaml
common:
  tags:
    - drivers
    - watchdog
  depends_on: watchdog
  harness: ztest

tests:
  drivers.watchdog.wdt_error_cases:
    filter: dt_compat_enabled("vnd,wdt")
```
