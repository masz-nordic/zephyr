## boards/native/nrf_bsim/board.yml
```yaml
boards:
- name: nrf52_bsim
  full_name: nRF52 simulated board (BabbleSim)
  vendor: zephyr
  socs:
  - name: native
- name: nrf5340bsim
  full_name: nRF5340 simulated boards (BabbleSim)
  vendor: zephyr
  socs:
  - name: nrf5340
# Note the 53 and 54 are referring to the real SOC yamls, but we only use their name and cpu-cluster
# definitions. In practice these board uses the same native SOC (SOC_POSIX) as the nrf52_bsim
```

## boards/nordic/nrf54l15pdk/nrf54l15pdk_nrf54l15_cpuflpr_defconfig
```kconfig
# Copyright (c) 2024 Nordic Semiconductor ASA
# SPDX-License-Identifier: LicenseRef-Nordic-5-Clause

CONFIG_DEBUG=y

CONFIG_NRF_GRTC_TIMER=y

CONFIG_PINCTRL=y

# Enable GPIO
CONFIG_GPIO=y

CONFIG_RISCV_ALWAYS_SWITCH_THROUGH_ECALL=y
```

## drivers/gpio/Kconfig.nrfe
```kconfig
# Copyright (c) 2024 Nordic Semiconductor ASA
# SPDX-License-Identifier: Apache-2.0

menuconfig GPIO_NRFE
	bool "Emulated GPIO"
	default y
	depends on DT_HAS_NORDIC_NRF_EGPIO_ENABLED
	select NRFE_GPIO if HAS_HW_NRF_EGPIO
	select IPC_SERVICE
	select IPC_SERVICE_BACKEND_ICMSG
	select MBOX
	help
	  Use emulated GPIO driver.

# eGPIO initialization depends on IPC initialization which is done at the same init level and
# has init priority equal to 46.
config EGPIO_INIT_PRIORITY
	int "eGPIO init priority"
	depends on GPIO_NRFE
	default 48
	help
	  eGPIO driver device initialization priority.
```

## dts/bindings/regulator/nordic,nrf54l-regulators.yaml
```yaml
# Copyright (c) 2024 Nordic Semiconductor ASA
# SPDX-License-Identifier: Apache-2.0

description: Nordic REGULATORS (voltage regulators control module) on nRF54L.


include: base.yaml

properties:
  reg:
    required: true
```

## modules/hal_nordic/nrfe/Kconfig
```kconfig
# Copyright (c) 2024 Nordic Semiconductor ASA
# SPDX-License-Identifier: Apache-2.0

config HAS_NRFE
	bool

menu "nRF Emulated Peripherals"
	depends on HAS_NRFE

config NRFE_GPIO
	bool "eGPIO driver instance"
	depends on $(dt_nodelabel_has_compat,egpio,$(DT_COMPAT_NORDIC_NRF_EGPIO))

endmenu
```

## samples/boards/nordic/system_off/sample.yaml
```yaml
sample:
  name: Low Power State Sample for nRF5x
common:
  tags: power
tests:
  sample.boards.nrf.system_off:
    integration_platforms:
      - nrf52840dk/nrf52840
    platform_allow:
      - nrf51dk/nrf51822
      - nrf52840dk/nrf52840
      - nrf52dk/nrf52832
      - nrf5340dk/nrf5340/cpuapp



    harness: console
    harness_config:
      type: multi_line
      ordered: true
      regex:
        - "system off demo"
        - "Retained data not supported"
        - "Entering system off; press sw0 to restart"
  sample.boards.nrf.system_off.retained_mem:
    integration_platforms:
      - nrf52840dk/nrf52840
    platform_allow:
      - nrf52840dk/nrf52840
      - nrf52dk/nrf52832
      - nrf5340dk/nrf5340/cpuapp



    extra_configs:
      - CONFIG_APP_USE_RETAINED_MEM=y
    harness: console
    harness_config:
      type: multi_line
      ordered: true
      regex:
        - "system off demo"
        - "Retained data: INVALID"
        - "Boot count: 1"
        - "Off count: 0"
        - "Active Ticks:"
        - "Entering system off; press sw0 to restart"
```

## soc/nordic/common/vpr/Kconfig.sysbuild
```kconfig
# Copyright (c) 2024 Nordic Semiconductor ASA
# SPDX-License-Identifier: Apache-2.0

config VPR_LAUNCHER
	bool "VPR launcher"
	depends on (SOC_NRF54H20_CPUPPR || SOC_NRF54L15_ENGA_CPUFLPR)
	help
	  Include VPR launcher hex for application core.
```

## soc/nordic/nrf54l/Kconfig.defconfig.nrf54l15_enga_cpuflpr
```kconfig
# Nordic Semiconductor nRF54L15 MCU

# Copyright (c) 2024 Nordic Semiconductor ASA
# SPDX-License-Identifier: LicenseRef-Nordic-5-Clause

if SOC_NRF54L15_ENGA_CPUFLPR

config RISCV_HAS_CPU_IDLE
	bool

config NUM_IRQS
	int
	default 480

endif # SOC_NRF54L15_ENGA_CPUFLPR
```

## tests/drivers/flash/negative_tests/testcase.yaml
```yaml
common:
  tags:
    - drivers
    - flash
tests:
  drivers.flash.negative_tests:
    platform_allow:
      
      - nrf54h20dk/nrf54h20/cpuapp
```

## tests/drivers/timer/nrf_grtc_timer/testcase.yaml
```yaml
tests:
  drivers.timer.nrf_grtc_timer:
    tags: drivers
    platform_allow:
      
      - nrf54h20dk/nrf54h20/cpuapp
      - nrf54h20dk/nrf54h20/cpurad
      - nrf54h20dk/nrf54h20/cpuppr
    integration_platforms:
```

## tests/drivers/watchdog/wdt_variables/testcase.yaml
```yaml
common:
  timeout: 10
  tags:
    - drivers
    - watchdog
  harness: console
  harness_config:
    type: one_line
    regex:
      - "Test completed successfully"

tests:
  drivers.watchdog.wdt_variables.default:
    platform_allow:
      - nrf54h20dk/nrf54h20/cpuapp
      - nrf54h20dk/nrf54h20/cpuppr
      
    integration_platforms:
      

  drivers.watchdog.wdt_variables.54h_flpr:
    platform_allow:
      - nrf54h20dk/nrf54h20/cpuflpr
    extra_args:
      - vpr_launcher_SNIPPET=nordic-log-stm
      - vpr_launcher_CONFIG_BOOT_BANNER=n
      - SNIPPET=nordic-log-stm
```
